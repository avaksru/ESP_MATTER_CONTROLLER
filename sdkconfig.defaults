## sdkconfig.defaults
```kconfig
CONFIG_ESPTOOLPY_FLASHSIZE_4MB=y

# Use SPIRAM and external alloc for RAM optimization
CONFIG_SPIRAM=y
CONFIG_SPIRAM_SPEED_80M=y
CONFIG_SPIRAM_MODE_OCT=y
CONFIG_SPIRAM_MALLOC_ALWAYSINTERNAL=512
CONFIG_SPIRAM_MALLOC_RESERVE_INTERNAL=16384
CONFIG_SPIRAM_TRY_ALLOCATE_WIFI_LWIP=y
CONFIG_BT_NIMBLE_MEM_ALLOC_MODE_EXTERNAL=y
CONFIG_ESP_MATTER_MEM_ALLOC_MODE_INTERNAL=y
CONFIG_MBEDTLS_EXTERNAL_MEM_ALLOC=n

#disable BT (not used in this project, causes linker errors)
CONFIG_BT_ENABLED=n
CONFIG_BT_NIMBLE_ENABLED=n

# Use a custom partition table
CONFIG_PARTITION_TABLE_CUSTOM=y
CONFIG_PARTITION_TABLE_FILENAME="partitions.csv"

# Testing Options
CONFIG_USE_TEST_SETUP_PIN_CODE=20212020
CONFIG_USE_TEST_SETUP_DISCRIMINATOR=0xF0

# Enable chip shell
CONFIG_ENABLE_CHIP_SHELL=y
CONFIG_ESP_MATTER_CONSOLE_TASK_STACK=4096

# lwip
CONFIG_LWIP_HOOK_IP6_ROUTE_DEFAULT=y
CONFIG_LWIP_HOOK_ND6_GET_GW_DEFAULT=y
CONFIG_LWIP_IPV6_AUTOCONFIG=y
CONFIG_LWIP_IPV6_NUM_ADDRESSES=4

# Reduce Stack size for memory optimization
CONFIG_CHIP_TASK_STACK_SIZE=4096
CONFIG_ESP_MAIN_TASK_STACK_SIZE=4096

# Reduce udp endpoints num for commissioner
CONFIG_NUM_UDP_ENDPOINTS=4

# Enable Controller and commissioner
CONFIG_ENABLE_CHIP_CONTROLLER_BUILD=y
CONFIG_ESP_MATTER_CONTROLLER_ENABLE=y
CONFIG_ESP_MATTER_COMMISSIONER_ENABLE=y

# Enable HKDF in mbedtls
CONFIG_MBEDTLS_HKDF_C=y

# Increase LwIP IPv6 address number to 6 (MAX_FABRIC + 1)
# unique local addresses for fabrics(MAX_FABRIC), a link local address(1)
CONFIG_LWIP_IPV6_NUM_ADDRESSES=6

# Enable project configurations
CONFIG_CHIP_PROJECT_CONFIG="main/matter_project_config.h"

# Reduce console buffer length
CONFIG_CHIP_SHELL_CMD_LINE_BUF_MAX_LENGTH=256

# Disable WiFi network commissioning driver
CONFIG_WIFI_NETWORK_COMMISSIONING_DRIVER=n

# Enable Openthread Border Router
CONFIG_OPENTHREAD_ENABLED=y
CONFIG_OPENTHREAD_LOG_LEVEL_DYNAMIC=n
CONFIG_OPENTHREAD_LOG_LEVEL_NOTE=y
CONFIG_OPENTHREAD_BORDER_ROUTER=y
CONFIG_OPENTHREAD_SRP_CLIENT=n
CONFIG_OPENTHREAD_DNS_CLIENT=n
CONFIG_THREAD_TASK_STACK_SIZE=2048

#LwIP config for OpenThread
CONFIG_LWIP_IPV6_AUTOCONFIG=y
CONFIG_LWIP_IPV6_NUM_ADDRESSES=4
CONFIG_LWIP_MULTICAST_PING=n
CONFIG_LWIP_IPV6_FORWARD=n
CONFIG_LWIP_HOOK_IP6_ROUTE_DEFAULT=y
CONFIG_LWIP_HOOK_ND6_GET_GW_DEFAULT=y
CONFIG_LWIP_NETIF_STATUS_CALLBACK=y

# Use a custom partition table
CONFIG_PARTITION_TABLE_CUSTOM=y
CONFIG_PARTITION_TABLE_CUSTOM_FILENAME="partitions_br.csv"

# mbedTLS
CONFIG_MBEDTLS_KEY_EXCHANGE_ECJPAKE=y
CONFIG_MBEDTLS_ECJPAKE_C=y
CONFIG_MBEDTLS_SSL_PROTO_DTLS=y

# MDNS platform
CONFIG_USE_MINIMAL_MDNS=n
CONFIG_ENABLE_EXTENDED_DISCOVERY=n
CONFIG_MDNS_MULTIPLE_INSTANCE=n

# Stack size already set above

# Wi-Fi Settings
CONFIG_ENABLE_WIFI_STATION=y
CONFIG_ENABLE_WIFI_AP=n

# Enable Controller and disable commissioner
CONFIG_ESP_MATTER_ENABLE_MATTER_SERVER=n
CONFIG_ESP_MATTER_CONTROLLER_CUSTOM_CLUSTER_ENABLE=n

# Disable chip test build
CONFIG_BUILD_CHIP_TESTS=n

# Disable OTA Requestor
CONFIG_ENABLE_OTA_REQUESTOR=n

# Disable route hook for matter since OTBR has already initialize the route hook
CONFIG_ENABLE_ROUTE_HOOK=n

# Use USB Jtag Console
CONFIG_ESP_CONSOLE_USB_SERIAL_JTAG=y

# LittleFS Configuration
CONFIG_LITTLEFS_SDMMC_SUPPORT=n
CONFIG_LITTLEFS_SPIFFS_COMPAT=n
CONFIG_LITTLEFS_PAGE_SIZE=256
CONFIG_LITTLEFS_BLOCK_SIZE=4096
CONFIG_LITTLEFS_BLOCK_CYCLES=512
CONFIG_LITTLEFS_CACHE_SIZE=128
CONFIG_LITTLEFS_LOOKAHEAD_SIZE=32
CONFIG_LITTLEFS_READ_SIZE=128
CONFIG_LITTLEFS_WRITE_SIZE=128
CONFIG_LITTLEFS_USE_MTIME=y

# Disable ble controller (requires Bluetooth)
CONFIG_ENABLE_ESP32_BLE_CONTROLLER=n

# Disable WiFi&Thread network commissioning driver
CONFIG_THREAD_NETWORK_COMMISSIONING_DRIVER=n
```

## sdkconfig.defaults.esp32s3
```kconfig
CONFIG_IDF_TARGET="esp32s3"

# Disable ble controller (not used in this project, causes linker errors)
CONFIG_ENABLE_ESP32_BLE_CONTROLLER=n

# Disable using ble for commissioning
CONFIG_USE_BLE_ONLY_FOR_COMMISSIONING=n

# Disable Matter server
CONFIG_ESP_MATTER_ENABLE_MATTER_SERVER=n

# Disable Bluetooth (not used in this project, causes linker errors)
CONFIG_BT_ENABLED=n
CONFIG_BT_NIMBLE_ENABLED=n
```
